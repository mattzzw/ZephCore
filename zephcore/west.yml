## zephcore/west.yml
```yaml
manifest:
  remotes:
    - name: zephyrproject-rtos
      url-base: https://github.com/zephyrproject-rtos

  projects:
    - name: hal_espressif
      remote: zephyrproject-rtos
      revision: cbf74978350266a45edbfb4508553a3990341dd2
      path: modules/hal/espressif
    - name: zephyr
      remote: zephyrproject-rtos
      revision: 149c8b1758a8ac6bd20ce230d2b1ae43c483ef30
      import: true

  self:
    path: zephcore
```
